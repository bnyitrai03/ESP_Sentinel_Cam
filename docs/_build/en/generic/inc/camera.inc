.. File automatically generated by 'gen-dxd.py'

Header File
^^^^^^^^^^^

* :project_file:`components/camera/include/camera.h`

Macros
^^^^^^

.. doxygendefine:: CAM_PIN_PWDN
.. doxygendefine:: CAM_PIN_RESET
.. doxygendefine:: CAM_PIN_XCLK
.. doxygendefine:: CAM_PIN_SIOD
.. doxygendefine:: CAM_PIN_SIOC
.. doxygendefine:: CAM_PIN_D7
.. doxygendefine:: CAM_PIN_D6
.. doxygendefine:: CAM_PIN_D5
.. doxygendefine:: CAM_PIN_D4
.. doxygendefine:: CAM_PIN_D3
.. doxygendefine:: CAM_PIN_D2
.. doxygendefine:: CAM_PIN_D1
.. doxygendefine:: CAM_PIN_D0
.. doxygendefine:: CAM_PIN_VSYNC
.. doxygendefine:: CAM_PIN_HREF
.. doxygendefine:: CAM_PIN_PCLK

Classes
^^^^^^^

.. doxygenclass:: Camera
    :members:


